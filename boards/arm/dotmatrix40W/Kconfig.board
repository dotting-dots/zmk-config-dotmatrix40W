## boards/arm/dotmatrix40W/Kconfig.board
```kconfig
# Copyright (c) 2021 Nick Winans
# SPDX-License-Identifier: MIT

config BOARD_DOTMATRIX40W
    bool "dotmatrix40W"
    depends on SOC_NRF52840_QIAA
```
